## app/Kconfig.sysbuild
```kconfig
# Copyright 2023 Nordic Semiconductor ASA
# Copyright 2023-2025 NXP
# Copyright 2025 Ezurio LLC
#
# SPDX-License-Identifier: Apache-2.0

source "share/sysbuild/Kconfig"

config REMOTE_BOARD
	string "Remote board"
	default "esp32c6_devkitc/esp32c6/lpcore" if "$(BOARD)/${BOARD_QUALIFIERS}" = "esp32c6_devkitc/esp32c6/hpcore"
```

## west.yml
```yaml
# Copyright (c) 2025 Espressif Systems (Shanghai) Co., Ltd.
# SPDX-License-Identifier: Apache-2.0

manifest:
  self:
    west-commands: scripts/west-commands.yml

  remotes:
    - name: zephyrproject-rtos
      url-base: https://github.com/zephyrproject-rtos
    - name: tambor
      url-base: https://github.com/LucasTambor
    - name: espressif
      url-base: ssh://git@gitlab.espressif.cn:27227/espressif

  projects:
    - name: zephyr
      remote: zephyrproject-rtos
      revision: main
      import: true
    - name: esp-bist
      remote: espressif
      revision: v1.0.0
```
